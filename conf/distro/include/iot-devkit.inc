## conf/distro/include/iot-devkit.inc
```bitbake
SANITY_TESTED_DISTROS = " \
            poky-1.6 \n \
            Ubuntu-12.04 \n \
            Ubuntu-14.04 \n \
            Fedora-20 \n \
            Debian-7.8 \n \
            openSUSE-project-13.1 \n \
            "

DISTRO_VERSION = "1.1"
DISTRO_CODENAME = "koala"
DISTRO_NAME = "iot-devkit (Intel IoT Development Kit)"
MAINTAINER = "Yocto Devkit <yocto-devkit@linux.intel.com>"

# Changing these currently breaks the Eclipse plugin
#TARGET_VENDOR = "-iotkit"
#SDK_VENDOR = "-iotkit"

SSTATE_DIR ?= "${TOPDIR}/../devkit-cache/sstate-cache"
CACHE_forcevariable = "${TOPDIR}/../devkit-cache/cache"
PERSISTENT_DIR = "${TOPDIR}/../devkit-cache/persistent"
```

## conf/distro/iot-devkit.conf
```bitbake
require conf/distro/poky.conf
require include/iot-devkit.inc

DISTRO = "iot-devkit"
DISTRO_FEATURES_append = " systemd"

PREFERRED_PROVIDER_virtual/kernel = "linux-yocto-clanton"
PREFERRED_VERSION_linux-yocto-clanton = "3.8%"
#PREFERRED_VERSION_grub = "0.97%"

# change these to something better
IMAGE_FSTYPES = "cpio.gz cpio.lzma"

PACKAGE_CLASSES = "package_ipk"

VIRTUAL-RUNTIME_dev_manager = "udev"
VIRTUAL-RUNTIME_init_manager = "systemd"
VIRTUAL-RUNTIME_initscripts = ""

DISTRO_FEATURES_BACKFILL_CONSIDERED = "sysvinit"
```

## conf/layer.conf
```bitbake
# We have a conf and classes directory, add to BBPATH
BBPATH := "${BBPATH}:${LAYERDIR}"

# We have a recipes directory, add to BBFILES
BBFILES := "${BBFILES} ${LAYERDIR}/recipes-*/*/*.bb \
	${LAYERDIR}/recipes-*/*/*.bbappend"

BBFILE_COLLECTIONS += "intel-iot-distro"
BBFILE_PATTERN_intel-iot-distro := "^${LAYERDIR}/"
BBFILE_PRIORITY_intel-iot-distro = "10"
```
